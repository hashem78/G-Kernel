## arch/arm/configs/jactive_eur_defconfig
```kconfig
CONFIG_MACH_JACTIVE_EUR=y
CONFIG_EXTRA_FIRMWARE="audience-es325-fw-jactive-eur.bin"
CONFIG_EXTRA_FIRMWARE_DIR="firmware"

CONFIG_FB_MSM_MIPI_RENESAS_TFT_VIDEO_FULL_HD_PT_PANEL=y
CONFIG_SUPPORT_DISPLAY_OCTA_TFT=y
CONFIG_FB_MSM_ENABLE_LCD_EN2=y
CONFIG_SUPPORT_SECOND_POWER=y
CONFIG_ESD_ERR_FG_RECOVERY=y
# CONFIG_FB_MSM_MIPI_SAMSUNG_OCTA_VIDEO_FULL_HD_PT_PANEL is not set
# CONFIG_LCD_VDD3_BY_PMGPIO is not set

# TSP
CONFIG_TOUCHSCREEN_SYNAPTICS_PREVENT_HSYNC_LEAKAGE=y

#
# Wifi features
#
CONFIG_WCNSS_CORE=n
CONFIG_WIRELESS_EXT=n
CONFIG_PRIMA_WLAN=n

CONFIG_NET_CORE=y
CONFIG_WIRELESS=y
CONFIG_WIRELESS_EXT_SYSFS=y
CONFIG_WEXT_CORE=y
CONFIG_WEXT_PROC=y
CONFIG_CFG80211=y
CONFIG_CFG80211_DEFAULT_PS=y
CONFIG_CFG80211_WEXT=y
CONFIG_CFG80211_ALLOW_RECONNECT=y
CONFIG_WLAN=y
CONFIG_WIFI_CONTROL_FUNC=y
CONFIG_BCM4335=m
CONFIG_BROADCOM_WIFI_RESERVED_MEM=y
CONFIG_WLAN_REGION_CODE=100
CONFIG_MMC_MSM_SDC4_SUPPORT=y

CONFIG_S5K3H5XA=y
CONFIG_S5K6B2YX=y
CONFIG_CAMERA_SW_I2C_ACT=y
CONFIG_IMX175_EEPROM=y

CONFIG_BT_HCISMD=n
CONFIG_BT_HCIUART_IBS=n
CONFIG_BT_HCIUART=y
CONFIG_BT_BCM4335=y

CONFIG_SERIAL_MSM=y
CONFIG_SERIAL_MSM_HS=y

CONFIG_SEC_TORCH_FLASH=y

# HALL IC is not supported
CONFIG_SENSORS_HALL=n

#CONFIG_SEC_DVFS_BOOSTER=n
CONFIG_FORCE_FAST_CHARGE=y
CONFIG_SOUND_CONTROL_HAX_GPL
CONFIG_F2FS_FS=y
CONFIG_F2FS_STAT_FS=y
CONFIG_F2FS_FS_XATTR=y
CONFIG_F2FS_FS_POSIX_ACL=y
CONFIG_F2FS_FS_SECURITY=y
CONFIG_BLK_DEV_DM_BUILTIN=y
# CONFIG_F2FS_CHECK_FS is not set

CONFIG_CPU_FREQ_GOV_INTELLIACTIVE=y
#CONFIG_SEC_DVFS_BOOSTER=n
CONFIG_FORCE_FAST_CHARGE=y
CONFIG_SOUND_CONTROL_HAX_GPL
CONFIG_F2FS_FS=y
CONFIG_F2FS_STAT_FS=y
CONFIG_F2FS_FS_XATTR=y
CONFIG_F2FS_FS_POSIX_ACL=y
CONFIG_F2FS_FS_SECURITY=y
CONFIG_BLK_DEV_DM_BUILTIN=y
# CONFIG_F2FS_CHECK_FS is not set

CONFIG_CPU_FREQ_GOV_INTELLIACTIVE=y
CONFIG_CPU_FREQ_GOV_LIONHEART=y
CONFIG_CPU_FREQ_GOV_LAGFREE=y
CONFIG_CPU_FREQ_GOV_SMARTASSV2=y
CONFIG_CPU_FREQ_GOV_WHEATLEY=y
CONFIG_CPU_FREQ_GOV_ONDEMANDPLUS=y
CONFIG_IOSCHED_BFQ=y
CONFIG_CGROUP_BFQIO=y
CONFIG_IOSCHED_SIO=y
CONFIG_IOSCHED_VR=y
CONFIG_IOSCHED_ZEN=y
CONFIG_EXFAT_FS=y
CONFIG_EXFAT_DEFAULT_CODEPAGE=y
CONFIG_EXFAT_DEFAULT_IOCHARSET=y
CONFIG_TURBO_BOOST=y
CONFIG_CPU_OVERCLOCK=y
CONFIG_OC_ULTIMATE=y
CONFIG_LOW_CPUCLOCKS=y
CONFIG_CPU_VOLTAGE_TABLE=y
CONFIG_LOCALVERSION="-G-kernel"
CONFIG_FRONTSWAP=y

###Se linux
# CONFIG_SECURITY_SELINUX_DEVELOP is not set
# CONFIG_SECURITY_SELINUX_AVC_STATS is not set
# CONFIG_SECURITY_SELINUX_CHECKREQPROT_VALUE is not set
# CONFIG_SECURITY_SELINUX is not set
# CONFIG_DEFAULT_SECURITY_SELINUX is not set
# CONFIG_DEFAULT_SECURITY is not set
```
